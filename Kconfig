## Kconfig
```kconfig
menu "rBPF"
    config RBPF_CONTAINER_PATH
        string "Location of container source code"
        default "container"

    config BPF_STORE_NUM_VALUES
        int "Maximum number of stored values"
        default 16
        help
            Space is shared between all stores (global and local).

    config BPF_USE_JUMPTABLE
        bool "Execute instructions using jump tables"
        default y
        help
            Uses single jump table instead of function-based engine.
            Requires slightly more flash memory, performance appears similar.

endmenu
```
